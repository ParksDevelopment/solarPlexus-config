## boards/shields/solarPlexus/Kconfig.defconfig
```kconfig
if SHIELD_SOLARPLEXUS_LEFT

config ZMK_KEYBOARD_NAME
    default "solarPlexus"

config ZMK_SPLIT_ROLE_CENTRAL
    default y

endif

if SHIELD_SOLARPLEXUS_LEFT || SHIELD_SOLARPLEXUS_RIGHT

config ZMK_SPLIT
    default y

endif
```

## boards/shields/solarPlexus/Kconfig.shield
```kconfig
config SHIELD_SOLARPLEXUS_LEFT
    def_bool $(shields_list_contains,solarPlexus_left)
config SHIELD_SOLARPLEXUS_RIGHT
    def_bool $(shields_list_contains,solarPlexus_right)
```
